## firmware/components/asr/Kconfig
```kconfig
menu "Speech recognizer engine"

choice ASR_ENGINE
    prompt "Engine that turns a TALK clip into word hypotheses"
    default ASR_ENGINE_DIY
    help
        All engines give the same output (voice_hyp_t: up to 5 guesses of lexicon word ids,
        confidences and a reject score), so the form engine (components/vform) and the router
        do not care which one runs. Bench them for speed, size and agreement.

config ASR_ENGINE_DIY
    bool "DIY int8 phoneme CTC model (pipeline/speech/fasr), plain C kernels"
    help
        Preferred. Causal depthwise-conv CTC model (0.5-1 M params), log-mel front end,
        lexicon-trie beam search with <unk> garbage, calibrated reject. Checked bit for bit against
        the speech thread's Python (host tests in this folder). Model/lexicon/calibration come from
        the cart's ASRM/LEXI/ASRC chunks (firmware/tools/cart_add.py).

config ASR_ENGINE_ESPDL
    bool "Same fasr model run through ESP-DL"
    help
        The fasr ONNX export quantized for ESP-DL. NOT BUILT YET.

config ASR_ENGINE_MULTINET
    bool "ESP-SR MultiNet (fallback, fixed phrase list)"
    help
        What main/voice.c does today: MultiNet with the phrase list in library/phrases.txt.
endchoice

config ASR_MAX_HYPS
    int "n-best guesses kept"
    range 1 5
    default 5

endmenu
```

## firmware/recorder/main/Kconfig.projbuild
```kconfig
menu "FASR recorder"

choice LIB_BOARD
    prompt "Board"
    default LIB_BOARD_PLAIN
config LIB_BOARD_PLAIN
    bool "Plain XIAO ESP32-S3 (bench: 3 buttons, mic on D4/D5 instead of the LED gates)"
config LIB_BOARD_PLUS
    bool "XIAO ESP32-S3 Plus"
endchoice

config LIB_PLUS_WHITE_GPIO
    int
    depends on LIB_BOARD_PLUS
    default 12

config REC_MIC_CLK
    int "PDM mic CLK GPIO"
    default 42 if LIB_BOARD_PLUS
    default 5
    help
        Plain bench board: D4 (GPIO5). Unplug the LED gate jumper from D4 first.
config REC_MIC_DATA
    int "PDM mic DATA GPIO"
    default 41 if LIB_BOARD_PLUS
    default 6
    help
        Plain bench board: D5 (GPIO6). Unplug the LED gate jumper from D5 first.
config REC_MIC_PWR
    int "PDM mic power GPIO (-1 = mic wired to 3V3)"
    default 39 if LIB_BOARD_PLUS
    default -1
config REC_EPD
    bool "E-ink panel wired (off: prompts only on the PC running fasr devrec)"
    default y
config REC_MIC_RIGHT
    bool "Read the PDM mic on the other clock edge (right slot)"
    default n
    help
        A PDM mic drives DATA on one clock edge chosen by its SEL pin and floats on the other.
        If every clip is a flat line, either move SEL (GND <-> 3V3) or flip this.
config REC_BUFFER_KB
    int "PSRAM kept for clips not yet copied to the PC (KB)"
    default 6144
endmenu
```

## firmware/tether/main/Kconfig.projbuild
```kconfig
menu "Voice tether"

choice LIB_BOARD
    prompt "Board"
    default LIB_BOARD_PLAIN
config LIB_BOARD_PLAIN
    bool "Plain XIAO ESP32-S3 (bench: 3 buttons, mic on D4/D5 instead of the LED gates)"
config LIB_BOARD_PLUS
    bool "XIAO ESP32-S3 Plus"
endchoice

config LIB_PLUS_WHITE_GPIO
    int
    depends on LIB_BOARD_PLUS
    default 12

config REC_MIC_CLK
    int "PDM mic CLK GPIO"
    default 42 if LIB_BOARD_PLUS
    default 5
    help
        Plain bench board: D4 (GPIO5). Unplug the LED gate jumper from D4 first.
config REC_MIC_DATA
    int "PDM mic DATA GPIO"
    default 41 if LIB_BOARD_PLUS
    default 6
    help
        Plain bench board: D5 (GPIO6). Unplug the LED gate jumper from D5 first.
config REC_MIC_PWR
    int "PDM mic power GPIO (-1 = mic wired to 3V3)"
    default 39 if LIB_BOARD_PLUS
    default -1
config REC_EPD
    bool "E-ink panel wired (off: screens only on the PC log)"
    default y
config REC_BUFFER_KB
    int "PSRAM kept for clips not yet copied to the PC (KB)"
    default 6144
config TETHER_BOARD_BRAIN
    bool "Board brain: run the fill-in-the-blanks form on the board (C, components/vform)"
    default n
    help
        The PC then only does speech: it sends "WORDS {hyps, reject}" and the board builds every
        screen itself, echoing each as "SHOWN <json>". Needs pc_bridge.py --board-brain.
        Build with -D TETHER_FPK=<form pack> (the real trees are personal; default: the fixture).
config TETHER_REJECT
    int "Speech reject score at or above which the board asks to say it again"
    depends on TETHER_BOARD_BRAIN
    range 0 101
    default 70
endmenu
```
